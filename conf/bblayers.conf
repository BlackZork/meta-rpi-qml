## conf/bblayers.conf
```bitbake
# POKY_BBLAYERS_CONF_VERSION is increased each time build/conf/bblayers.conf
# changes incompatibly
POKY_BBLAYERS_CONF_VERSION = "2"

BBPATH = "${TOPDIR}"
BBFILES ?= ""

BBLAYERS += " \
    SRCDIR/poky/meta \
    SRCDIR/poky/meta-poky \
    SRCDIR/poky/meta-openembedded/meta-oe \
    SRCDIR/poky/meta-openembedded/meta-python \
    SRCDIR/poky/meta-openembedded/meta-networking \
    SRCDIR/poky/meta-openembedded/meta-perl \
    SRCDIR/poky/meta-qt5 \    
    SRCDIR/poky/meta-raspberrypi \
    SRCDIR/meta-rpi-qml \
"
```

## conf/layer.conf
```bitbake
# We have a conf and classes directory, append to BBPATH
BBPATH .= ":${LAYERDIR}"

# We have a recipes directory, add to BBFILES
BBFILES += "${LAYERDIR}/recipes*/*/*.bb ${LAYERDIR}/recipes*/*/*.bbappend ${LAYERDIR}/images/*.bb"

BBFILE_COLLECTIONS += "meta-rpi-qml"
BBFILE_PATTERN_meta-rpi-qml := "^${LAYERDIR}/"
BBFILE_PRIORITY_meta-rpi-qml = "16"

LAYERSERIES_COMPAT_meta-rpi-qml = "dunfell"

KERNEL_DEVICETREE_append = " \
  overlays/rpi-backlight.dtbo \
"
```

## conf/local.conf
```bitbake
# Part of local.conf appended from meta-rpi-qml

BB_NUMBER_THREADS = "3"
PARALLEL_MAKE = "-j 3"

# Choose the board you are building for
#MACHINE = "raspberrypi"
#MACHINE = "raspberrypi0"
#MACHINE = "raspberrypi0-wifi"
#MACHINE = "raspberrypi2"
MACHINE = "raspberrypi3"
#MACHINE = "raspberrypi4"
#MACHINE = "raspberrypi-cm"
#MACHINE = "raspberrypi-cm3"

RM_OLD_IMAGE = "1"
INHERIT += "rm_work"

# The poky distribution configuration (DISTRO = "poky") enables ptests by default to enable runtime testing of various components. 
# In this release, a dependency needed to be added that has resulted in a significant increase in the number of components that will 
# be built just when building a simple image such as core-image-minimal. If you do not need runtime tests enabled for core components, 
# then it is recommended that you remove "ptest" from DISTRO_FEATURES to save a significant amount of build time e.g. by adding the following in your configuration:
DISTRO_FEATURES_remove = "ptest"
```
